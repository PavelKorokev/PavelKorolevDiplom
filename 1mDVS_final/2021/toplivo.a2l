ASAP2_VERSION 1 70
/begin PROJECT toplivo "toplivo"
/begin HEADER "toplivo" VERSION "0" PROJECT_NO toplivo /end HEADER
/begin MODULE toplivo "toplivo"
/begin MOD_PAR "toplivo" ADDR_EPK 0x0100 EPK "96348C0B215660351ABB57AB0D945E04" SUPPLIER "ETAS" ECU "toplivo Simulink XCP" CPU_TYPE "toplivo Simulink" /*********** MEMORY_SEGMENT ***********/
 /begin MEMORY_SEGMENT CODE "Program data" CODE FLASH INTERN 0x0000 0x0100 -1 -1 -1 -1 -1
  /begin IF_DATA XCP
   /begin SEGMENT 0x00 0x01 0x00 0x00 0x00 /begin CHECKSUM XCP_ADD_14 /end CHECKSUM
    /begin PAGE 0x00 ECU_ACCESS_WITH_XCP_ONLY XCP_READ_ACCESS_WITH_ECU_ONLY XCP_WRITE_ACCESS_NOT_ALLOWED /end PAGE
   /end SEGMENT
  /end IF_DATA
 /end MEMORY_SEGMENT
 /begin MEMORY_SEGMENT EPK_SEGMENT "EPK Segment" CODE FLASH INTERN 0x0100 0x0020 -1 -1 -1 -1 -1
  /begin IF_DATA XCP
   /begin SEGMENT 0x01 0x01 0x00 0x00 0x00 /begin CHECKSUM XCP_ADD_14 /end CHECKSUM
    /begin PAGE 0x00 ECU_ACCESS_WITH_XCP_ONLY XCP_READ_ACCESS_WITH_ECU_ONLY XCP_WRITE_ACCESS_NOT_ALLOWED /end PAGE
   /end SEGMENT
  /end IF_DATA
 /end MEMORY_SEGMENT
 /begin MEMORY_SEGMENT CALIBRATIONS "Calibrations Segment" DATA FLASH EXTERN 0x0120 0x0130 -1 -1 -1 -1 -1
  /begin IF_DATA XCP
   /begin SEGMENT 0x02 0x01 0x00 0x00 0x00 /begin CHECKSUM XCP_ADD_14 /end CHECKSUM
    /begin PAGE 0x00 ECU_ACCESS_WITH_XCP_ONLY XCP_READ_ACCESS_WITH_ECU_ONLY XCP_WRITE_ACCESS_WITH_ECU_ONLY /end PAGE
   /end SEGMENT
  /end IF_DATA
 /end MEMORY_SEGMENT
 /begin MEMORY_SEGMENT MEASUREMENTS "Measurements Segment" VARIABLES RAM INTERN 0x0250 0x00e0 -1 -1 -1 -1 -1
  /begin IF_DATA XCP
   /begin SEGMENT 0x03 0x01 0x00 0x00 0x00 /end SEGMENT
  /end IF_DATA
 /end MEMORY_SEGMENT
/end MOD_PAR
/begin MOD_COMMON "XCP Simulator" BYTE_ORDER MSB_LAST /end MOD_COMMON
/*********** IF_DATA XCP ***********/
/begin IF_DATA XCP
 /begin PROTOCOL_LAYER 0x0100 2000 2000 2000 2000 2000 0005 0005 0xfa 0x05b8 BYTE_ORDER_MSB_LAST ADDRESS_GRANULARITY_BYTE OPTIONAL_CMD SET_MTA OPTIONAL_CMD UPLOAD OPTIONAL_CMD BUILD_CHECKSUM OPTIONAL_CMD DOWNLOAD OPTIONAL_CMD DOWNLOAD_NEXT COMMUNICATION_MODE_SUPPORTED /begin BLOCK SLAVE MASTER 0xf0 100 /end BLOCK /end PROTOCOL_LAYER
 /begin DAQ STATIC 0x01 0x01 0x00 OPTIMISATION_TYPE_DEFAULT ADDRESS_EXTENSION_FREE IDENTIFICATION_FIELD_TYPE_ABSOLUTE GRANULARITY_ODT_ENTRY_SIZE_DAQ_BYTE 0x08 NO_OVERLOAD_INDICATION /begin STIM GRANULARITY_ODT_ENTRY_SIZE_STIM_BYTE 0x08 /end STIM /begin TIMESTAMP_SUPPORTED 1 SIZE_DWORD UNIT_100NS /end TIMESTAMP_SUPPORTED
  /begin DAQ_LIST 0 DAQ_LIST_TYPE DAQ MAX_ODT 0xfc MAX_ODT_ENTRIES 0xb7 FIRST_PID 0x00 EVENT_FIXED 0 /end DAQ_LIST
  /begin EVENT "All_Samples" "All_Samples" 0 DAQ 0x01 0x00 0x09 0x00 /end EVENT
 /end DAQ
 /begin PAG 0x04 FREEZE_SUPPORTED /end PAG
 /begin PGM PGM_MODE_ABSOLUTE 0x01 0x00 /begin SECTOR "dummy sector" 0x00 0x888888 0x222222 0x00 0x00 0x00 /end SECTOR /end PGM
 /begin XCP_ON_TCP_IP 0x0100 4599 ADDRESS "127.0.0.1" /end XCP_ON_TCP_IP
/end IF_DATA
/*********** MEASUREMENT ***********/
/begin MEASUREMENT D_Out "" FLOAT32_IEEE CONVERSION_table_1 0 0 -3.402823466385289e+38 3.402823466385289e+38 BIT_MASK 0xFFFFFFFF ECU_ADDRESS 0x250 FORMAT "13.3%" /end MEASUREMENT
/begin MEASUREMENT Error "" FLOAT64_IEEE CONVERSION_table_1 0 0 -1.797693134862316e+308 1.797693134862316e+308 BIT_MASK 0xFFFFFFFF ECU_ADDRESS 0x260 FORMAT "13.3%" /end MEASUREMENT
/begin MEASUREMENT I_Out "" FLOAT32_IEEE CONVERSION_table_1 0 0 -3.402823466385289e+38 3.402823466385289e+38 BIT_MASK 0xFFFFFFFF ECU_ADDRESS 0x270 FORMAT "13.3%" /end MEASUREMENT
/begin MEASUREMENT PIDOUT "" FLOAT32_IEEE CONVERSION_table_1 0 0 -3.402823466385289e+38 3.402823466385289e+38 BIT_MASK 0xFFFFFFFF ECU_ADDRESS 0x280 FORMAT "13.3%" /end MEASUREMENT
/begin MEASUREMENT P_Out "" FLOAT32_IEEE CONVERSION_table_1 0 0 -3.402823466385289e+38 3.402823466385289e+38 BIT_MASK 0xFFFFFFFF ECU_ADDRESS 0x290 FORMAT "13.3%" /end MEASUREMENT
/begin MEASUREMENT Rail_press "" FLOAT64_IEEE CONVERSION_table_1 0 0 -1.797693134862316e+308 1.797693134862316e+308 BIT_MASK 0xFFFFFFFF ECU_ADDRESS 0x2a0 FORMAT "13.3%" /end MEASUREMENT
/begin MEASUREMENT p_set "" FLOAT64_IEEE CONVERSION_table_1 0 0 -1.797693134862316e+308 1.797693134862316e+308 BIT_MASK 0xFFFFFFFF ECU_ADDRESS 0x2b0 FORMAT "13.3%" /end MEASUREMENT
/begin MEASUREMENT p_set_saturation "" FLOAT64_IEEE CONVERSION_table_1 0 0 -1.797693134862316e+308 1.797693134862316e+308 BIT_MASK 0xFFFFFFFF ECU_ADDRESS 0x2c0 FORMAT "13.3%" /end MEASUREMENT
/begin MEASUREMENT q_inj_out "" FLOAT64_IEEE CONVERSION_table_1 0 0 -1.797693134862316e+308 1.797693134862316e+308 BIT_MASK 0xFFFFFFFF ECU_ADDRESS 0x2d0 FORMAT "13.3%" /end MEASUREMENT
/begin MEASUREMENT q_pump_out "" FLOAT64_IEEE CONVERSION_table_1 0 0 -1.797693134862316e+308 1.797693134862316e+308 BIT_MASK 0xFFFFFFFF ECU_ADDRESS 0x2e0 FORMAT "13.3%" /end MEASUREMENT
/begin MEASUREMENT q_sum_out "" FLOAT64_IEEE CONVERSION_table_1 0 0 -1.797693134862316e+308 1.797693134862316e+308 BIT_MASK 0xFFFFFFFF ECU_ADDRESS 0x2f0 FORMAT "13.3%" /end MEASUREMENT
/begin MEASUREMENT q_sum_out_1 "" FLOAT64_IEEE CONVERSION_table_1 0 0 -1.797693134862316e+308 1.797693134862316e+308 BIT_MASK 0xFFFFFFFF ECU_ADDRESS 0x300 FORMAT "13.3%" /end MEASUREMENT
/begin MEASUREMENT q_valve_out "" FLOAT64_IEEE CONVERSION_table_1 0 0 -1.797693134862316e+308 1.797693134862316e+308 BIT_MASK 0xFFFFFFFF ECU_ADDRESS 0x310 FORMAT "13.3%" /end MEASUREMENT
/begin MEASUREMENT valve_open_fl "" FLOAT64_IEEE CONVERSION_table_1 0 0 -1.797693134862316e+308 1.797693134862316e+308 BIT_MASK 0xFFFFFFFF ECU_ADDRESS 0x320 FORMAT "13.3%" /end MEASUREMENT
/*********** CHARACTERISTIC ***********/
/begin CHARACTERISTIC C "" VALUE 0x120 FNC_VALUES_FLOAT64_IEEE_RESERVED_8 0 CONVERSION_table_1 -1.797693134862316e+308 1.797693134862316e+308 NUMBER 1 /end CHARACTERISTIC
/begin CHARACTERISTIC Constant "" VALUE 0x130 FNC_VALUES_FLOAT64_IEEE_RESERVED_8 0 CONVERSION_table_1 -1.797693134862316e+308 1.797693134862316e+308 NUMBER 1 /end CHARACTERISTIC
/begin CHARACTERISTIC Constant1 "" VALUE 0x140 FNC_VALUES_FLOAT64_IEEE_RESERVED_8 0 CONVERSION_table_1 -1.797693134862316e+308 1.797693134862316e+308 NUMBER 1 /end CHARACTERISTIC
/begin CHARACTERISTIC Constant1_1 "" VALUE 0x150 FNC_VALUES_FLOAT64_IEEE_RESERVED_8 0 CONVERSION_table_1 -1.797693134862316e+308 1.797693134862316e+308 NUMBER 1 /end CHARACTERISTIC
/begin CHARACTERISTIC Constant2 "" VALUE 0x160 FNC_VALUES_FLOAT64_IEEE_RESERVED_8 0 CONVERSION_table_1 -1.797693134862316e+308 1.797693134862316e+308 NUMBER 1 /end CHARACTERISTIC
/begin CHARACTERISTIC Constant3 "" VALUE 0x170 FNC_VALUES_FLOAT64_IEEE_RESERVED_8 0 CONVERSION_table_1 -1.797693134862316e+308 1.797693134862316e+308 NUMBER 1 /end CHARACTERISTIC
/begin CHARACTERISTIC Constant4 "" VALUE 0x180 FNC_VALUES_FLOAT64_IEEE_RESERVED_8 0 CONVERSION_table_1 -1.797693134862316e+308 1.797693134862316e+308 NUMBER 1 /end CHARACTERISTIC
/begin CHARACTERISTIC D_coef "" VALUE 0x190 FNC_VALUES_FLOAT64_IEEE_RESERVED_8 0 CONVERSION_table_1 -1.797693134862316e+308 1.797693134862316e+308 NUMBER 1 /end CHARACTERISTIC
/begin CHARACTERISTIC I_coef "" VALUE 0x1a0 FNC_VALUES_FLOAT64_IEEE_RESERVED_8 0 CONVERSION_table_1 -1.797693134862316e+308 1.797693134862316e+308 NUMBER 1 /end CHARACTERISTIC
/begin CHARACTERISTIC K "" VALUE 0x1b0 FNC_VALUES_FLOAT64_IEEE_RESERVED_8 0 CONVERSION_table_1 -1.797693134862316e+308 1.797693134862316e+308 NUMBER 1 /end CHARACTERISTIC
/begin CHARACTERISTIC K1Filter__ "" VALUE 0x1c0 FNC_VALUES_FLOAT64_IEEE_RESERVED_8 0 CONVERSION_table_1 -1.797693134862316e+308 1.797693134862316e+308 NUMBER 1 /end CHARACTERISTIC
/begin CHARACTERISTIC P_Set_ "" VALUE 0x1d0 FNC_VALUES_FLOAT64_IEEE_RESERVED_8 0 CONVERSION_table_1 -1.797693134862316e+308 1.797693134862316e+308 NUMBER 1 /end CHARACTERISTIC
/begin CHARACTERISTIC P_coef "" VALUE 0x1e0 FNC_VALUES_FLOAT64_IEEE_RESERVED_8 0 CONVERSION_table_1 -1.797693134862316e+308 1.797693134862316e+308 NUMBER 1 /end CHARACTERISTIC
/begin CHARACTERISTIC RealTimeBlock.mode "" VALUE 0x1f0 FNC_VALUES_SLONG_RESERVED_12 0 CONVERSION_table_2 -2147483648 2147483647 NUMBER 1 /end CHARACTERISTIC
/begin CHARACTERISTIC RealTimeBlock.realTimeMultiplier "" VALUE 0x200 FNC_VALUES_FLOAT64_IEEE_RESERVED_8 0 CONVERSION_table_1 -1.797693134862316e+308 1.797693134862316e+308 NUMBER 1 /end CHARACTERISTIC
/begin CHARACTERISTIC TsID "" VALUE 0x210 FNC_VALUES_FLOAT64_IEEE_RESERVED_8 0 CONVERSION_table_1 -1.797693134862316e+308 1.797693134862316e+308 NUMBER 1 /end CHARACTERISTIC
/begin CHARACTERISTIC m "" VALUE 0x220 FNC_VALUES_FLOAT64_IEEE_RESERVED_8 0 CONVERSION_table_1 -1.797693134862316e+308 1.797693134862316e+308 NUMBER 1 /end CHARACTERISTIC
/begin CHARACTERISTIC q_Vlv_set "" VALUE 0x230 FNC_VALUES_FLOAT64_IEEE_RESERVED_8 0 CONVERSION_table_1 -1.797693134862316e+308 1.797693134862316e+308 NUMBER 1 /end CHARACTERISTIC
/begin CHARACTERISTIC q_inj_set "" VALUE 0x240 FNC_VALUES_FLOAT64_IEEE_RESERVED_8 0 CONVERSION_table_1 -1.797693134862316e+308 1.797693134862316e+308 NUMBER 1 /end CHARACTERISTIC
/*********** GROUP_AXES ***********/
/*********** RECORD_LAYOUT **********/
/begin RECORD_LAYOUT FNC_VALUES_FLOAT64_IEEE_RESERVED_8 FNC_VALUES 1 FLOAT64_IEEE COLUMN_DIR DIRECT RESERVED 2 BYTE RESERVED 3 BYTE RESERVED 4 BYTE RESERVED 5 BYTE RESERVED 6 BYTE RESERVED 7 BYTE RESERVED 8 BYTE RESERVED 9 BYTE /end RECORD_LAYOUT
/begin RECORD_LAYOUT FNC_VALUES_SLONG_RESERVED_12 FNC_VALUES 1 SLONG COLUMN_DIR DIRECT RESERVED 2 BYTE RESERVED 3 BYTE RESERVED 4 BYTE RESERVED 5 BYTE RESERVED 6 BYTE RESERVED 7 BYTE RESERVED 8 BYTE RESERVED 9 BYTE RESERVED 10 BYTE RESERVED 11 BYTE RESERVED 12 BYTE RESERVED 13 BYTE /end RECORD_LAYOUT
/*********** COMPU_METHOD ***********/
/begin COMPU_METHOD CONVERSION_table_1 "" IDENTICAL "%10.5" "" /end COMPU_METHOD
/begin COMPU_METHOD CONVERSION_table_2 "Conversion method for class mode" TAB_VERB "%7.5" "" COMPU_TAB_REF COMPU_VTAB_table_2 /end COMPU_METHOD
/begin COMPU_VTAB COMPU_VTAB_table_2 "" TAB_VERB 2 0 "Real Time" 1 "Fast Emulation" /end COMPU_VTAB
/*********** MODEL GROUPS ***********/
/begin GROUP toplivo "toplivo" ROOT /begin SUB_GROUP Rail HPP_Inj_Valve ETAS_SIP /end SUB_GROUP
 /begin REF_CHARACTERISTIC Constant1 Constant2 Constant3 Constant4 D_coef I_coef K1Filter__ P_Set_ P_coef TsID /end REF_CHARACTERISTIC
 /begin REF_MEASUREMENT D_Out Error I_Out PIDOUT P_Out Rail_press p_set p_set_saturation valve_open_fl /end REF_MEASUREMENT
/end GROUP
/begin GROUP Rail "toplivo/Rail" /begin SUB_GROUP /end SUB_GROUP /begin REF_CHARACTERISTIC C K m /end REF_CHARACTERISTIC /begin REF_MEASUREMENT Rail_press /end REF_MEASUREMENT /end GROUP
/begin GROUP HPP_Inj_Valve "toplivo/HPP_Inj_Valve" /begin SUB_GROUP /end SUB_GROUP /begin REF_CHARACTERISTIC Constant Constant1_1 q_Vlv_set q_inj_set /end REF_CHARACTERISTIC /begin REF_MEASUREMENT q_inj_out q_pump_out q_sum_out q_sum_out_1 q_valve_out /end REF_MEASUREMENT /end GROUP
/begin GROUP ETAS_SIP "toplivo/ETAS_SIP" /begin SUB_GROUP /end SUB_GROUP /begin REF_CHARACTERISTIC RealTimeBlock.mode RealTimeBlock.realTimeMultiplier /end REF_CHARACTERISTIC /begin REF_MEASUREMENT /end REF_MEASUREMENT /end GROUP
/end MODULE
/end PROJECT
