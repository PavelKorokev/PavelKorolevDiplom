ASAP2_VERSION 1 41
/begin PROJECT PIDTest_PC "Generated by ETAS from Project PIDTest_PC"
/begin HEADER "" VERSION "000" PROJECT_NO ASD /end HEADER
/begin MODULE PIDTest_PC "Generated by ETAS ASCET7 from Project: PIDTest_PC"
/begin IF_DATA E_TARGET
 /begin SOURCE "Task0" 3 /* period */ 10 QP_BLOB 1 /end SOURCE
 /begin TP_BLOB /* programm id */ 1191217133 /* target id */ 7 0 2 0 /end TP_BLOB
/end IF_DATA
/begin MOD_PAR "" VERSION "000" ADDR_EPK 0x0 EPK "" SUPPLIER "ETAS GmbH" CUSTOMER "xxx" CUSTOMER_NO "000" USER "xxx" PHONE_NO "000" ECU "PC" CPU_TYPE "PCx86" NO_OF_INTERFACES 1 /end MOD_PAR
/begin MOD_COMMON "Common definitions" BYTE_ORDER MSB_LAST ALIGNMENT_BYTE 1 ALIGNMENT_WORD 2 ALIGNMENT_LONG 4 ALIGNMENT_FLOAT32_IEEE 4 ALIGNMENT_FLOAT64_IEEE 8 /end MOD_COMMON
/begin MEASUREMENT components.PIDTest.tester.Delay.memory1 "" FLOAT64_IEEE esdl_ident 1 100.0 -1.7976931348623157E+308 1.7976931348623157E+308 ECU_ADDRESS 0x0 /end MEASUREMENT
/begin MEASUREMENT components.PIDTest.tester.Delay.memory2 "" FLOAT64_IEEE esdl_ident 1 100.0 -1.7976931348623157E+308 1.7976931348623157E+308 ECU_ADDRESS 0x0 /end MEASUREMENT
/begin MEASUREMENT components.PIDTest.tester.pMemory "" FLOAT32_IEEE esdl_ident 1 100.0 -3.4028234663852886E+38 3.4028234663852886E+38 ECU_ADDRESS 0x0 /end MEASUREMENT
/begin MEASUREMENT components.PIDTest.tester.pPressureError "" FLOAT32_IEEE esdl_ident 1 100.0 -3.4028234663852886E+38 3.4028234663852886E+38 ECU_ADDRESS 0x0 /end MEASUREMENT
/begin CHARACTERISTIC components.PIDTest.Out_InpPressure "" VALUE 0x0 STANDARD_VALUE_R32 0.0 esdl_ident -3.4028234663852886E+38 3.4028234663852886E+38 /end CHARACTERISTIC
/begin CHARACTERISTIC components.PIDTest.Out_PressureSet "" VALUE 0x0 STANDARD_VALUE_R32 0.0 esdl_ident -3.4028234663852886E+38 3.4028234663852886E+38 /end CHARACTERISTIC
/begin CHARACTERISTIC components.PIDTest.Out_qP "" VALUE 0x0 STANDARD_VALUE_R32 0.0 esdl_ident -3.4028234663852886E+38 3.4028234663852886E+38 /end CHARACTERISTIC
/begin CHARACTERISTIC components.PIDTest.Out_qI "" VALUE 0x0 STANDARD_VALUE_R32 0.0 esdl_ident -3.4028234663852886E+38 3.4028234663852886E+38 /end CHARACTERISTIC
/begin CHARACTERISTIC components.PIDTest.Out_qD "" VALUE 0x0 STANDARD_VALUE_R32 0.0 esdl_ident -3.4028234663852886E+38 3.4028234663852886E+38 /end CHARACTERISTIC
/begin MEASUREMENT components.PIDTest.Out_return "" FLOAT32_IEEE esdl_ident 1 100.0 -3.4028234663852886E+38 3.4028234663852886E+38 ECU_ADDRESS 0x0 /end MEASUREMENT
/begin COMPU_METHOD esdl_ident "" RAT_FUNC /* format */ "%12.4" /* unit */ "" /* coeffs */ COEFFS 0 1 0 0 0 1 /end COMPU_METHOD
/begin FUNCTION components.PIDTest ""
 /begin DEF_CHARACTERISTIC components.PIDTest.Out_InpPressure components.PIDTest.Out_PressureSet components.PIDTest.Out_qP components.PIDTest.Out_qI components.PIDTest.Out_qD /end DEF_CHARACTERISTIC
 /begin LOC_MEASUREMENT components.PIDTest.Out_return /end LOC_MEASUREMENT
 /begin SUB_FUNCTION components.PIDTest.tester /end SUB_FUNCTION
/end FUNCTION
/begin FUNCTION components.PIDTest.tester ""
 /begin LOC_MEASUREMENT components.PIDTest.tester.pMemory components.PIDTest.tester.pPressureError /end LOC_MEASUREMENT
 /begin SUB_FUNCTION components.PIDTest.tester.Delay /end SUB_FUNCTION
/end FUNCTION
/begin FUNCTION components.PIDTest.tester.Delay "DelayValue delays its input value by one evaluation step."
 /begin LOC_MEASUREMENT components.PIDTest.tester.Delay.memory1 components.PIDTest.tester.Delay.memory2 /end LOC_MEASUREMENT
/end FUNCTION
/begin RECORD_LAYOUT STANDARD_VALUE_R32 /* value */ FNC_VALUES 1 FLOAT32_IEEE COLUMN_DIR DIRECT /end RECORD_LAYOUT
/begin GROUP components.PIDTest "" ROOT
 /begin REF_CHARACTERISTIC components.PIDTest.Out_InpPressure components.PIDTest.Out_PressureSet components.PIDTest.Out_qP components.PIDTest.Out_qI components.PIDTest.Out_qD /end REF_CHARACTERISTIC
 /begin REF_MEASUREMENT components.PIDTest.Out_return /end REF_MEASUREMENT
 /begin SUB_GROUP components.PIDTest.tester /end SUB_GROUP
/end GROUP
/begin GROUP components.PIDTest.tester ""
 /begin REF_MEASUREMENT components.PIDTest.tester.pMemory components.PIDTest.tester.pPressureError /end REF_MEASUREMENT
 /begin SUB_GROUP components.PIDTest.tester.Delay /end SUB_GROUP
/end GROUP
/begin GROUP components.PIDTest.tester.Delay "DelayValue delays its input value by one evaluation step."
 /begin REF_MEASUREMENT components.PIDTest.tester.Delay.memory1 components.PIDTest.tester.Delay.memory2 /end REF_MEASUREMENT
/end GROUP
/end MODULE
/end PROJECT
