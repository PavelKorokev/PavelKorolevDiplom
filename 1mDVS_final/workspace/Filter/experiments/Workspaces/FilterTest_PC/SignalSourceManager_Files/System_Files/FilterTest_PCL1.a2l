ASAP2_VERSION 1 41
/begin PROJECT FilterTest_PC "Generated by ETAS from Project FilterTest_PC"
/begin HEADER "" VERSION "000" PROJECT_NO ASD /end HEADER
/begin MODULE FilterTest_PC "Generated by ETAS ASCET7 from Project: FilterTest_PC"
/begin IF_DATA E_TARGET
 /begin SOURCE "Task0" 3 /* period */ 10 QP_BLOB 1 /end SOURCE
 /begin TP_BLOB /* programm id */ 2197833673 /* target id */ 7 0 2 0 /end TP_BLOB
/end IF_DATA
/begin MOD_PAR "" VERSION "000" ADDR_EPK 0x0 EPK "" SUPPLIER "ETAS GmbH" CUSTOMER "xxx" CUSTOMER_NO "000" USER "xxx" PHONE_NO "000" ECU "PC" CPU_TYPE "PCx86" NO_OF_INTERFACES 1 /end MOD_PAR
/begin MOD_COMMON "Common definitions" BYTE_ORDER MSB_LAST ALIGNMENT_BYTE 1 ALIGNMENT_WORD 2 ALIGNMENT_LONG 4 ALIGNMENT_FLOAT32_IEEE 4 ALIGNMENT_FLOAT64_IEEE 8 /end MOD_COMMON
/begin MEASUREMENT components.FilterTest.tester.DelayValue_instance.memory1 "" FLOAT64_IEEE esdl_ident 1 100.0 -1.7976931348623157E+308 1.7976931348623157E+308 ECU_ADDRESS 0x0 /end MEASUREMENT
/begin MEASUREMENT components.FilterTest.tester.DelayValue_instance.memory2 "" FLOAT64_IEEE esdl_ident 1 100.0 -1.7976931348623157E+308 1.7976931348623157E+308 ECU_ADDRESS 0x0 /end MEASUREMENT
/begin CHARACTERISTIC components.FilterTest.tester.K1 "" VALUE 0x0 STANDARD_VALUE_R32 0.0 esdl_ident -3.4028234663852886E+38 3.4028234663852886E+38 /end CHARACTERISTIC
/begin CHARACTERISTIC components.FilterTest.tester.K2 "" VALUE 0x0 STANDARD_VALUE_R32 0.0 esdl_ident -3.4028234663852886E+38 3.4028234663852886E+38 /end CHARACTERISTIC
/begin CHARACTERISTIC components.FilterTest.Filter_Inp "" VALUE 0x0 STANDARD_VALUE_R32 0.0 esdl_ident -3.4028234663852886E+38 3.4028234663852886E+38 /end CHARACTERISTIC
/begin MEASUREMENT components.FilterTest.Filter_return "" FLOAT32_IEEE esdl_ident 1 100.0 -3.4028234663852886E+38 3.4028234663852886E+38 ECU_ADDRESS 0x0 /end MEASUREMENT
/begin COMPU_METHOD esdl_ident "" RAT_FUNC /* format */ "%12.4" /* unit */ "" /* coeffs */ COEFFS 0 1 0 0 0 1 /end COMPU_METHOD
/begin FUNCTION components.FilterTest "" /begin DEF_CHARACTERISTIC components.FilterTest.Filter_Inp /end DEF_CHARACTERISTIC /begin LOC_MEASUREMENT components.FilterTest.Filter_return /end LOC_MEASUREMENT /begin SUB_FUNCTION components.FilterTest.tester /end SUB_FUNCTION /end FUNCTION
/begin FUNCTION components.FilterTest.tester ""
 /begin DEF_CHARACTERISTIC components.FilterTest.tester.K1 components.FilterTest.tester.K2 /end DEF_CHARACTERISTIC
 /begin SUB_FUNCTION components.FilterTest.tester.DelayValue_instance /end SUB_FUNCTION
/end FUNCTION
/begin FUNCTION components.FilterTest.tester.DelayValue_instance "DelayValue delays its input value by one evaluation step."
 /begin LOC_MEASUREMENT components.FilterTest.tester.DelayValue_instance.memory1 components.FilterTest.tester.DelayValue_instance.memory2 /end LOC_MEASUREMENT
/end FUNCTION
/begin RECORD_LAYOUT STANDARD_VALUE_R32 /* value */ FNC_VALUES 1 FLOAT32_IEEE COLUMN_DIR DIRECT /end RECORD_LAYOUT
/begin GROUP components.FilterTest "" ROOT /begin REF_CHARACTERISTIC components.FilterTest.Filter_Inp /end REF_CHARACTERISTIC /begin REF_MEASUREMENT components.FilterTest.Filter_return /end REF_MEASUREMENT /begin SUB_GROUP components.FilterTest.tester /end SUB_GROUP /end GROUP
/begin GROUP components.FilterTest.tester ""
 /begin REF_CHARACTERISTIC components.FilterTest.tester.K1 components.FilterTest.tester.K2 /end REF_CHARACTERISTIC
 /begin SUB_GROUP components.FilterTest.tester.DelayValue_instance /end SUB_GROUP
/end GROUP
/begin GROUP components.FilterTest.tester.DelayValue_instance "DelayValue delays its input value by one evaluation step."
 /begin REF_MEASUREMENT components.FilterTest.tester.DelayValue_instance.memory1 components.FilterTest.tester.DelayValue_instance.memory2 /end REF_MEASUREMENT
/end GROUP
/end MODULE
/end PROJECT
