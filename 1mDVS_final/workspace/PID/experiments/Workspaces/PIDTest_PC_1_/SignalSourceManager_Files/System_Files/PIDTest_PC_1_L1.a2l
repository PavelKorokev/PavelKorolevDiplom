ASAP2_VERSION 1 41
/begin PROJECT PIDTest_PC_1_ "Generated by ETAS from Project PIDTest_PC_1_"
/begin HEADER "" VERSION "000" PROJECT_NO ASD /end HEADER
/begin MODULE PIDTest_PC_1_ "Generated by ETAS ASCET7 from Project: PIDTest_PC_1_"
/begin IF_DATA E_TARGET
 /begin SOURCE "Task0" 3 /* period */ 10 QP_BLOB 1 /end SOURCE
 /begin TP_BLOB /* programm id */ 3078641438 /* target id */ 7 0 2 0 /end TP_BLOB
/end IF_DATA
/begin MOD_PAR "" VERSION "000" ADDR_EPK 0x0 EPK "" SUPPLIER "ETAS GmbH" CUSTOMER "xxx" CUSTOMER_NO "000" USER "xxx" PHONE_NO "000" ECU "PC" CPU_TYPE "PCx86" NO_OF_INTERFACES 1 /end MOD_PAR
/begin MOD_COMMON "Common definitions" BYTE_ORDER MSB_LAST ALIGNMENT_BYTE 1 ALIGNMENT_WORD 2 ALIGNMENT_LONG 4 ALIGNMENT_FLOAT32_IEEE 4 ALIGNMENT_FLOAT64_IEEE 8 /end MOD_COMMON
/begin MEASUREMENT PID.PIDTest.tester.DelayValue_instance_5.memory1 "" FLOAT64_IEEE esdl_ident 1 100.0 -1.7976931348623157E+308 1.7976931348623157E+308 ECU_ADDRESS 0x0 /end MEASUREMENT
/begin MEASUREMENT PID.PIDTest.tester.DelayValue_instance_5.memory2 "" FLOAT64_IEEE esdl_ident 1 100.0 -1.7976931348623157E+308 1.7976931348623157E+308 ECU_ADDRESS 0x0 /end MEASUREMENT
/begin MEASUREMENT PID.PIDTest.tester.pMemory "" FLOAT32_IEEE esdl_ident 1 100.0 -3.4028234663852886E+38 3.4028234663852886E+38 ECU_ADDRESS 0x0 /end MEASUREMENT
/begin CHARACTERISTIC PID.PIDTest.tester.cP_Max "" VALUE 0x0 STANDARD_VALUE_R32 0.0 esdl_ident -3.4028234663852886E+38 3.4028234663852886E+38 /end CHARACTERISTIC
/begin CHARACTERISTIC PID.PIDTest.tester.cP_Min "" VALUE 0x0 STANDARD_VALUE_R32 0.0 esdl_ident -3.4028234663852886E+38 3.4028234663852886E+38 /end CHARACTERISTIC
/begin CHARACTERISTIC PID.PIDTest.tester.cI_Max "" VALUE 0x0 STANDARD_VALUE_R32 0.0 esdl_ident -3.4028234663852886E+38 3.4028234663852886E+38 /end CHARACTERISTIC
/begin CHARACTERISTIC PID.PIDTest.tester.cD_Max "" VALUE 0x0 STANDARD_VALUE_R32 0.0 esdl_ident -3.4028234663852886E+38 3.4028234663852886E+38 /end CHARACTERISTIC
/begin CHARACTERISTIC PID.PIDTest.tester.cD_Min "" VALUE 0x0 STANDARD_VALUE_R32 0.0 esdl_ident -3.4028234663852886E+38 3.4028234663852886E+38 /end CHARACTERISTIC
/begin CHARACTERISTIC PID.PIDTest.tester.c "" VALUE 0x0 STANDARD_VALUE_R32 0.0 esdl_ident -3.4028234663852886E+38 3.4028234663852886E+38 /end CHARACTERISTIC
/begin CHARACTERISTIC PID.PIDTest.tester.cI_Min "" VALUE 0x0 STANDARD_VALUE_R32 0.0 esdl_ident -3.4028234663852886E+38 3.4028234663852886E+38 /end CHARACTERISTIC
/begin MEASUREMENT PID.PIDTest.tester.afterP "" FLOAT32_IEEE esdl_ident 1 100.0 -3.4028234663852886E+38 3.4028234663852886E+38 ECU_ADDRESS 0x0 /end MEASUREMENT
/begin MEASUREMENT PID.PIDTest.tester.afterI "" FLOAT32_IEEE esdl_ident 1 100.0 -3.4028234663852886E+38 3.4028234663852886E+38 ECU_ADDRESS 0x0 /end MEASUREMENT
/begin MEASUREMENT PID.PIDTest.tester.afterD "" FLOAT32_IEEE esdl_ident 1 100.0 -3.4028234663852886E+38 3.4028234663852886E+38 ECU_ADDRESS 0x0 /end MEASUREMENT
/begin MEASUREMENT PID.PIDTest.tester.Error "" FLOAT32_IEEE esdl_ident 1 100.0 -3.4028234663852886E+38 3.4028234663852886E+38 ECU_ADDRESS 0x0 /end MEASUREMENT
/begin MEASUREMENT PID.PIDTest.tester.InpOsc "" FLOAT32_IEEE esdl_ident 1 100.0 -3.4028234663852886E+38 3.4028234663852886E+38 ECU_ADDRESS 0x0 /end MEASUREMENT
/begin CHARACTERISTIC PID.PIDTest.Regulator_PressureSet "" VALUE 0x0 STANDARD_VALUE_R32 0.0 esdl_ident -3.4028234663852886E+38 3.4028234663852886E+38 /end CHARACTERISTIC
/begin CHARACTERISTIC PID.PIDTest.Regulator_InpPressure "" VALUE 0x0 STANDARD_VALUE_R32 0.0 esdl_ident -3.4028234663852886E+38 3.4028234663852886E+38 /end CHARACTERISTIC
/begin CHARACTERISTIC PID.PIDTest.Regulator_qP "" VALUE 0x0 STANDARD_VALUE_R32 0.0 esdl_ident -3.4028234663852886E+38 3.4028234663852886E+38 /end CHARACTERISTIC
/begin CHARACTERISTIC PID.PIDTest.Regulator_qI "" VALUE 0x0 STANDARD_VALUE_R32 0.0 esdl_ident -3.4028234663852886E+38 3.4028234663852886E+38 /end CHARACTERISTIC
/begin CHARACTERISTIC PID.PIDTest.Regulator_qD "" VALUE 0x0 STANDARD_VALUE_R32 0.0 esdl_ident -3.4028234663852886E+38 3.4028234663852886E+38 /end CHARACTERISTIC
/begin CHARACTERISTIC PID.PIDTest.Regulator_dT_ "" VALUE 0x0 STANDARD_VALUE_R32 0.0 esdl_ident -3.4028234663852886E+38 3.4028234663852886E+38 /end CHARACTERISTIC
/begin MEASUREMENT PID.PIDTest.Regulator_return "" FLOAT32_IEEE esdl_ident 1 100.0 -3.4028234663852886E+38 3.4028234663852886E+38 ECU_ADDRESS 0x0 /end MEASUREMENT
/begin COMPU_METHOD esdl_ident "" RAT_FUNC /* format */ "%12.4" /* unit */ "" /* coeffs */ COEFFS 0 1 0 0 0 1 /end COMPU_METHOD
/begin FUNCTION PID.PIDTest ""
 /begin DEF_CHARACTERISTIC PID.PIDTest.Regulator_PressureSet PID.PIDTest.Regulator_InpPressure PID.PIDTest.Regulator_qP PID.PIDTest.Regulator_qI PID.PIDTest.Regulator_qD PID.PIDTest.Regulator_dT_ /end DEF_CHARACTERISTIC
 /begin LOC_MEASUREMENT PID.PIDTest.Regulator_return /end LOC_MEASUREMENT
 /begin SUB_FUNCTION PID.PIDTest.tester /end SUB_FUNCTION
/end FUNCTION
/begin FUNCTION PID.PIDTest.tester ""
 /begin DEF_CHARACTERISTIC PID.PIDTest.tester.cP_Max PID.PIDTest.tester.cP_Min PID.PIDTest.tester.cI_Max PID.PIDTest.tester.cD_Max PID.PIDTest.tester.cD_Min PID.PIDTest.tester.c PID.PIDTest.tester.cI_Min /end DEF_CHARACTERISTIC
 /begin LOC_MEASUREMENT PID.PIDTest.tester.Error PID.PIDTest.tester.InpOsc PID.PIDTest.tester.afterD PID.PIDTest.tester.afterI PID.PIDTest.tester.afterP PID.PIDTest.tester.pMemory /end LOC_MEASUREMENT
 /begin SUB_FUNCTION PID.PIDTest.tester.DelayValue_instance_5 /end SUB_FUNCTION
/end FUNCTION
/begin FUNCTION PID.PIDTest.tester.DelayValue_instance_5 "DelayValue delays its input value by one evaluation step."
 /begin LOC_MEASUREMENT PID.PIDTest.tester.DelayValue_instance_5.memory1 PID.PIDTest.tester.DelayValue_instance_5.memory2 /end LOC_MEASUREMENT
/end FUNCTION
/begin RECORD_LAYOUT STANDARD_VALUE_R32 /* value */ FNC_VALUES 1 FLOAT32_IEEE COLUMN_DIR DIRECT /end RECORD_LAYOUT
/begin GROUP PID.PIDTest "" ROOT
 /begin REF_CHARACTERISTIC PID.PIDTest.Regulator_PressureSet PID.PIDTest.Regulator_InpPressure PID.PIDTest.Regulator_qP PID.PIDTest.Regulator_qI PID.PIDTest.Regulator_qD PID.PIDTest.Regulator_dT_ /end REF_CHARACTERISTIC
 /begin REF_MEASUREMENT PID.PIDTest.Regulator_return /end REF_MEASUREMENT
 /begin SUB_GROUP PID.PIDTest.tester /end SUB_GROUP
/end GROUP
/begin GROUP PID.PIDTest.tester ""
 /begin REF_CHARACTERISTIC PID.PIDTest.tester.cP_Max PID.PIDTest.tester.cP_Min PID.PIDTest.tester.cI_Max PID.PIDTest.tester.cD_Max PID.PIDTest.tester.cD_Min PID.PIDTest.tester.c PID.PIDTest.tester.cI_Min /end REF_CHARACTERISTIC
 /begin REF_MEASUREMENT PID.PIDTest.tester.Error PID.PIDTest.tester.InpOsc PID.PIDTest.tester.afterD PID.PIDTest.tester.afterI PID.PIDTest.tester.afterP PID.PIDTest.tester.pMemory /end REF_MEASUREMENT
 /begin SUB_GROUP PID.PIDTest.tester.DelayValue_instance_5 /end SUB_GROUP
/end GROUP
/begin GROUP PID.PIDTest.tester.DelayValue_instance_5 "DelayValue delays its input value by one evaluation step."
 /begin REF_MEASUREMENT PID.PIDTest.tester.DelayValue_instance_5.memory1 PID.PIDTest.tester.DelayValue_instance_5.memory2 /end REF_MEASUREMENT
/end GROUP
/end MODULE
/end PROJECT
