ASAP2_VERSION 1 41
/begin PROJECT ComponentTest_PC_5_ "Generated by ETAS from Project ComponentTest_PC_5_"
/begin HEADER "" VERSION "000" PROJECT_NO ASD /end HEADER
/begin MODULE ComponentTest_PC_5_ "Generated by ETAS ASCET7 from Project: ComponentTest_PC_5_"
/begin IF_DATA E_TARGET
 /begin SOURCE "Task0" 3 /* period */ 10 QP_BLOB 1 /end SOURCE
 /begin TP_BLOB /* programm id */ 3959442232 /* target id */ 7 0 2 0 /end TP_BLOB
/end IF_DATA
/begin MOD_PAR "" VERSION "000" ADDR_EPK 0x0 EPK "" SUPPLIER "ETAS GmbH" CUSTOMER "xxx" CUSTOMER_NO "000" USER "xxx" PHONE_NO "000" ECU "PC" CPU_TYPE "PCx86" NO_OF_INTERFACES 1 /end MOD_PAR
/begin MOD_COMMON "Common definitions" BYTE_ORDER MSB_LAST ALIGNMENT_BYTE 1 ALIGNMENT_WORD 2 ALIGNMENT_LONG 4 ALIGNMENT_FLOAT32_IEEE 4 ALIGNMENT_FLOAT64_IEEE 8 /end MOD_COMMON
/begin MEASUREMENT components.ComponentTest.tester.PID_instance.DelayValue_instance_5.memory1 "" FLOAT64_IEEE esdl_ident 1 100.0 -1.7976931348623157E+308 1.7976931348623157E+308 ECU_ADDRESS 0x0 /end MEASUREMENT
/begin MEASUREMENT components.ComponentTest.tester.PID_instance.DelayValue_instance_5.memory2 "" FLOAT64_IEEE esdl_ident 1 100.0 -1.7976931348623157E+308 1.7976931348623157E+308 ECU_ADDRESS 0x0 /end MEASUREMENT
/begin MEASUREMENT components.ComponentTest.tester.PID_instance.pMemory "" FLOAT32_IEEE esdl_ident 1 100.0 -3.4028234663852886E+38 3.4028234663852886E+38 ECU_ADDRESS 0x0 /end MEASUREMENT
/begin CHARACTERISTIC components.ComponentTest.tester.PID_instance.cP_Max "" VALUE 0x0 STANDARD_VALUE_R32 0.0 esdl_ident -3.4028234663852886E+38 3.4028234663852886E+38 /end CHARACTERISTIC
/begin CHARACTERISTIC components.ComponentTest.tester.PID_instance.cP_Min "" VALUE 0x0 STANDARD_VALUE_R32 0.0 esdl_ident -3.4028234663852886E+38 3.4028234663852886E+38 /end CHARACTERISTIC
/begin CHARACTERISTIC components.ComponentTest.tester.PID_instance.cI_Max "" VALUE 0x0 STANDARD_VALUE_R32 0.0 esdl_ident -3.4028234663852886E+38 3.4028234663852886E+38 /end CHARACTERISTIC
/begin CHARACTERISTIC components.ComponentTest.tester.PID_instance.cD_Max "" VALUE 0x0 STANDARD_VALUE_R32 0.0 esdl_ident -3.4028234663852886E+38 3.4028234663852886E+38 /end CHARACTERISTIC
/begin CHARACTERISTIC components.ComponentTest.tester.PID_instance.cD_Min "" VALUE 0x0 STANDARD_VALUE_R32 0.0 esdl_ident -3.4028234663852886E+38 3.4028234663852886E+38 /end CHARACTERISTIC
/begin CHARACTERISTIC components.ComponentTest.tester.PID_instance.c "" VALUE 0x0 STANDARD_VALUE_R32 0.0 esdl_ident -3.4028234663852886E+38 3.4028234663852886E+38 /end CHARACTERISTIC
/begin CHARACTERISTIC components.ComponentTest.tester.PID_instance.cI_Min "" VALUE 0x0 STANDARD_VALUE_R32 0.0 esdl_ident -3.4028234663852886E+38 3.4028234663852886E+38 /end CHARACTERISTIC
/begin MEASUREMENT components.ComponentTest.tester.PID_instance.afterP "" FLOAT32_IEEE esdl_ident 1 100.0 -3.4028234663852886E+38 3.4028234663852886E+38 ECU_ADDRESS 0x0 /end MEASUREMENT
/begin MEASUREMENT components.ComponentTest.tester.PID_instance.afterI "" FLOAT32_IEEE esdl_ident 1 100.0 -3.4028234663852886E+38 3.4028234663852886E+38 ECU_ADDRESS 0x0 /end MEASUREMENT
/begin MEASUREMENT components.ComponentTest.tester.PID_instance.afterD "" FLOAT32_IEEE esdl_ident 1 100.0 -3.4028234663852886E+38 3.4028234663852886E+38 ECU_ADDRESS 0x0 /end MEASUREMENT
/begin MEASUREMENT components.ComponentTest.tester.PID_instance.Error "" FLOAT32_IEEE esdl_ident 1 100.0 -3.4028234663852886E+38 3.4028234663852886E+38 ECU_ADDRESS 0x0 /end MEASUREMENT
/begin MEASUREMENT components.ComponentTest.tester.PID_instance.InpOsc "" FLOAT32_IEEE esdl_ident 1 100.0 -3.4028234663852886E+38 3.4028234663852886E+38 ECU_ADDRESS 0x0 /end MEASUREMENT
/begin CHARACTERISTIC components.ComponentTest.tester.PID_instance.cPID_Max "" VALUE 0x0 STANDARD_VALUE_R32 0.0 esdl_ident -3.4028234663852886E+38 3.4028234663852886E+38 /end CHARACTERISTIC
/begin CHARACTERISTIC components.ComponentTest.tester.PID_instance.cPID_Min "" VALUE 0x0 STANDARD_VALUE_R32 0.0 esdl_ident -3.4028234663852886E+38 3.4028234663852886E+38 /end CHARACTERISTIC
/begin MEASUREMENT components.ComponentTest.tester.RunningAverage_instance.DelayValue_instance.memory1 "" FLOAT64_IEEE esdl_ident 1 100.0 -1.7976931348623157E+308 1.7976931348623157E+308 ECU_ADDRESS 0x0 /end MEASUREMENT
/begin MEASUREMENT components.ComponentTest.tester.RunningAverage_instance.DelayValue_instance.memory2 "" FLOAT64_IEEE esdl_ident 1 100.0 -1.7976931348623157E+308 1.7976931348623157E+308 ECU_ADDRESS 0x0 /end MEASUREMENT
/begin MEASUREMENT components.ComponentTest.tester.RunningAverage_instance.DelayValue_instance_2.memory1 "" FLOAT64_IEEE esdl_ident 1 100.0 -1.7976931348623157E+308 1.7976931348623157E+308 ECU_ADDRESS 0x0 /end MEASUREMENT
/begin MEASUREMENT components.ComponentTest.tester.RunningAverage_instance.DelayValue_instance_2.memory2 "" FLOAT64_IEEE esdl_ident 1 100.0 -1.7976931348623157E+308 1.7976931348623157E+308 ECU_ADDRESS 0x0 /end MEASUREMENT
/begin MEASUREMENT components.ComponentTest.tester.RunningAverage_instance.DelayValue_instance_3.memory1 "" FLOAT64_IEEE esdl_ident 1 100.0 -1.7976931348623157E+308 1.7976931348623157E+308 ECU_ADDRESS 0x0 /end MEASUREMENT
/begin MEASUREMENT components.ComponentTest.tester.RunningAverage_instance.DelayValue_instance_3.memory2 "" FLOAT64_IEEE esdl_ident 1 100.0 -1.7976931348623157E+308 1.7976931348623157E+308 ECU_ADDRESS 0x0 /end MEASUREMENT
/begin MEASUREMENT components.ComponentTest.tester.RunningAverage_instance.DelayValue_instance_4.memory1 "" FLOAT64_IEEE esdl_ident 1 100.0 -1.7976931348623157E+308 1.7976931348623157E+308 ECU_ADDRESS 0x0 /end MEASUREMENT
/begin MEASUREMENT components.ComponentTest.tester.RunningAverage_instance.DelayValue_instance_4.memory2 "" FLOAT64_IEEE esdl_ident 1 100.0 -1.7976931348623157E+308 1.7976931348623157E+308 ECU_ADDRESS 0x0 /end MEASUREMENT
/begin MEASUREMENT components.ComponentTest.tester.RunningAverage_instance.DelayValue_instance_5.memory1 "" FLOAT64_IEEE esdl_ident 1 100.0 -1.7976931348623157E+308 1.7976931348623157E+308 ECU_ADDRESS 0x0 /end MEASUREMENT
/begin MEASUREMENT components.ComponentTest.tester.RunningAverage_instance.DelayValue_instance_5.memory2 "" FLOAT64_IEEE esdl_ident 1 100.0 -1.7976931348623157E+308 1.7976931348623157E+308 ECU_ADDRESS 0x0 /end MEASUREMENT
/begin MEASUREMENT components.ComponentTest.tester.RunningAverage_instance.DelayValue_instance_6.memory1 "" FLOAT64_IEEE esdl_ident 1 100.0 -1.7976931348623157E+308 1.7976931348623157E+308 ECU_ADDRESS 0x0 /end MEASUREMENT
/begin MEASUREMENT components.ComponentTest.tester.RunningAverage_instance.DelayValue_instance_6.memory2 "" FLOAT64_IEEE esdl_ident 1 100.0 -1.7976931348623157E+308 1.7976931348623157E+308 ECU_ADDRESS 0x0 /end MEASUREMENT
/begin MEASUREMENT components.ComponentTest.tester.RunningAverage_instance.DelayValue_instance_7.memory1 "" FLOAT64_IEEE esdl_ident 1 100.0 -1.7976931348623157E+308 1.7976931348623157E+308 ECU_ADDRESS 0x0 /end MEASUREMENT
/begin MEASUREMENT components.ComponentTest.tester.RunningAverage_instance.DelayValue_instance_7.memory2 "" FLOAT64_IEEE esdl_ident 1 100.0 -1.7976931348623157E+308 1.7976931348623157E+308 ECU_ADDRESS 0x0 /end MEASUREMENT
/begin MEASUREMENT components.ComponentTest.tester.RunningAverage_instance.DelayValue_instance_8.memory1 "" FLOAT64_IEEE esdl_ident 1 100.0 -1.7976931348623157E+308 1.7976931348623157E+308 ECU_ADDRESS 0x0 /end MEASUREMENT
/begin MEASUREMENT components.ComponentTest.tester.RunningAverage_instance.DelayValue_instance_8.memory2 "" FLOAT64_IEEE esdl_ident 1 100.0 -1.7976931348623157E+308 1.7976931348623157E+308 ECU_ADDRESS 0x0 /end MEASUREMENT
/begin MEASUREMENT components.ComponentTest.tester.RunningAverage_instance.DelayValue_instance_9.memory1 "" FLOAT64_IEEE esdl_ident 1 100.0 -1.7976931348623157E+308 1.7976931348623157E+308 ECU_ADDRESS 0x0 /end MEASUREMENT
/begin MEASUREMENT components.ComponentTest.tester.RunningAverage_instance.DelayValue_instance_9.memory2 "" FLOAT64_IEEE esdl_ident 1 100.0 -1.7976931348623157E+308 1.7976931348623157E+308 ECU_ADDRESS 0x0 /end MEASUREMENT
/begin CHARACTERISTIC components.ComponentTest.tester.RunningAverage_instance.c1 "" VALUE 0x0 STANDARD_VALUE_R32 0.0 esdl_ident -3.4028234663852886E+38 3.4028234663852886E+38 /end CHARACTERISTIC
/begin MEASUREMENT components.ComponentTest.tester.FilterBy_instance.DelayValue_instance.memory1 "" FLOAT64_IEEE esdl_ident 1 100.0 -1.7976931348623157E+308 1.7976931348623157E+308 ECU_ADDRESS 0x0 /end MEASUREMENT
/begin MEASUREMENT components.ComponentTest.tester.FilterBy_instance.DelayValue_instance.memory2 "" FLOAT64_IEEE esdl_ident 1 100.0 -1.7976931348623157E+308 1.7976931348623157E+308 ECU_ADDRESS 0x0 /end MEASUREMENT
/begin CHARACTERISTIC components.ComponentTest.tester.FilterBy_instance.K1 "" VALUE 0x0 STANDARD_VALUE_R32 0.0 esdl_ident -3.4028234663852886E+38 3.4028234663852886E+38 /end CHARACTERISTIC
/begin CHARACTERISTIC components.ComponentTest.tester.FilterBy_instance.K2 "" VALUE 0x0 STANDARD_VALUE_R32 0.0 esdl_ident -3.4028234663852886E+38 3.4028234663852886E+38 /end CHARACTERISTIC
/begin MEASUREMENT components.ComponentTest.tester.afterInp "" FLOAT32_IEEE esdl_ident 1 100.0 -3.4028234663852886E+38 3.4028234663852886E+38 ECU_ADDRESS 0x0 /end MEASUREMENT
/begin MEASUREMENT components.ComponentTest.tester.afterFilt "" FLOAT32_IEEE esdl_ident 1 100.0 -3.4028234663852886E+38 3.4028234663852886E+38 ECU_ADDRESS 0x0 /end MEASUREMENT
/begin MEASUREMENT components.ComponentTest.tester.afterRunAv "" FLOAT32_IEEE esdl_ident 1 100.0 -3.4028234663852886E+38 3.4028234663852886E+38 ECU_ADDRESS 0x0 /end MEASUREMENT
/begin CHARACTERISTIC components.ComponentTest.calc_Input "" VALUE 0x0 STANDARD_VALUE_R32 0.0 esdl_ident -3.4028234663852886E+38 3.4028234663852886E+38 /end CHARACTERISTIC
/begin CHARACTERISTIC components.ComponentTest.calc_Ts "" VALUE 0x0 STANDARD_VALUE_R32 0.0 esdl_ident -3.4028234663852886E+38 3.4028234663852886E+38 /end CHARACTERISTIC
/begin CHARACTERISTIC components.ComponentTest.calc_qP "" VALUE 0x0 STANDARD_VALUE_R32 0.0 esdl_ident -3.4028234663852886E+38 3.4028234663852886E+38 /end CHARACTERISTIC
/begin CHARACTERISTIC components.ComponentTest.calc_qI "" VALUE 0x0 STANDARD_VALUE_R32 0.0 esdl_ident -3.4028234663852886E+38 3.4028234663852886E+38 /end CHARACTERISTIC
/begin CHARACTERISTIC components.ComponentTest.calc_qD "" VALUE 0x0 STANDARD_VALUE_R32 0.0 esdl_ident -3.4028234663852886E+38 3.4028234663852886E+38 /end CHARACTERISTIC
/begin CHARACTERISTIC components.ComponentTest.calc_PressSet "" VALUE 0x0 STANDARD_VALUE_R32 0.0 esdl_ident -3.4028234663852886E+38 3.4028234663852886E+38 /end CHARACTERISTIC
/begin MEASUREMENT components.ComponentTest.calc_return "" FLOAT32_IEEE esdl_ident 1 100.0 -3.4028234663852886E+38 3.4028234663852886E+38 ECU_ADDRESS 0x0 /end MEASUREMENT
/begin COMPU_METHOD esdl_ident "" RAT_FUNC /* format */ "%12.4" /* unit */ "" /* coeffs */ COEFFS 0 1 0 0 0 1 /end COMPU_METHOD
/begin FUNCTION components.ComponentTest ""
 /begin DEF_CHARACTERISTIC components.ComponentTest.calc_Input components.ComponentTest.calc_Ts components.ComponentTest.calc_qP components.ComponentTest.calc_qI components.ComponentTest.calc_qD components.ComponentTest.calc_PressSet /end DEF_CHARACTERISTIC
 /begin LOC_MEASUREMENT components.ComponentTest.calc_return /end LOC_MEASUREMENT
 /begin SUB_FUNCTION components.ComponentTest.tester /end SUB_FUNCTION
/end FUNCTION
/begin FUNCTION components.ComponentTest.tester ""
 /begin LOC_MEASUREMENT components.ComponentTest.tester.afterFilt components.ComponentTest.tester.afterInp components.ComponentTest.tester.afterRunAv /end LOC_MEASUREMENT
 /begin SUB_FUNCTION components.ComponentTest.tester.FilterBy_instance components.ComponentTest.tester.PID_instance components.ComponentTest.tester.RunningAverage_instance /end SUB_FUNCTION
/end FUNCTION
/begin FUNCTION components.ComponentTest.tester.PID_instance ""
 /begin DEF_CHARACTERISTIC components.ComponentTest.tester.PID_instance.cP_Max components.ComponentTest.tester.PID_instance.cP_Min components.ComponentTest.tester.PID_instance.cI_Max components.ComponentTest.tester.PID_instance.cD_Max components.ComponentTest.tester.PID_instance.cD_Min components.ComponentTest.tester.PID_instance.c components.ComponentTest.tester.PID_instance.cI_Min components.ComponentTest.tester.PID_instance.cPID_Max components.ComponentTest.tester.PID_instance.cPID_Min /end DEF_CHARACTERISTIC
 /begin LOC_MEASUREMENT components.ComponentTest.tester.PID_instance.Error components.ComponentTest.tester.PID_instance.InpOsc components.ComponentTest.tester.PID_instance.afterD components.ComponentTest.tester.PID_instance.afterI components.ComponentTest.tester.PID_instance.afterP components.ComponentTest.tester.PID_instance.pMemory /end LOC_MEASUREMENT
 /begin SUB_FUNCTION components.ComponentTest.tester.PID_instance.DelayValue_instance_5 /end SUB_FUNCTION
/end FUNCTION
/begin FUNCTION components.ComponentTest.tester.PID_instance.DelayValue_instance_5 "DelayValue delays its input value by one evaluation step."
 /begin LOC_MEASUREMENT components.ComponentTest.tester.PID_instance.DelayValue_instance_5.memory1 components.ComponentTest.tester.PID_instance.DelayValue_instance_5.memory2 /end LOC_MEASUREMENT
/end FUNCTION
/begin FUNCTION components.ComponentTest.tester.RunningAverage_instance "" /begin DEF_CHARACTERISTIC components.ComponentTest.tester.RunningAverage_instance.c1 /end DEF_CHARACTERISTIC
 /begin SUB_FUNCTION components.ComponentTest.tester.RunningAverage_instance.DelayValue_instance components.ComponentTest.tester.RunningAverage_instance.DelayValue_instance_2 components.ComponentTest.tester.RunningAverage_instance.DelayValue_instance_3 components.ComponentTest.tester.RunningAverage_instance.DelayValue_instance_4 components.ComponentTest.tester.RunningAverage_instance.DelayValue_instance_5 components.ComponentTest.tester.RunningAverage_instance.DelayValue_instance_6 components.ComponentTest.tester.RunningAverage_instance.DelayValue_instance_7 components.ComponentTest.tester.RunningAverage_instance.DelayValue_instance_8 components.ComponentTest.tester.RunningAverage_instance.DelayValue_instance_9 /end SUB_FUNCTION
/end FUNCTION
/begin FUNCTION components.ComponentTest.tester.RunningAverage_instance.DelayValue_instance "DelayValue delays its input value by one evaluation step."
 /begin LOC_MEASUREMENT components.ComponentTest.tester.RunningAverage_instance.DelayValue_instance.memory1 components.ComponentTest.tester.RunningAverage_instance.DelayValue_instance.memory2 /end LOC_MEASUREMENT
/end FUNCTION
/begin FUNCTION components.ComponentTest.tester.RunningAverage_instance.DelayValue_instance_2 "DelayValue delays its input value by one evaluation step."
 /begin LOC_MEASUREMENT components.ComponentTest.tester.RunningAverage_instance.DelayValue_instance_2.memory1 components.ComponentTest.tester.RunningAverage_instance.DelayValue_instance_2.memory2 /end LOC_MEASUREMENT
/end FUNCTION
/begin FUNCTION components.ComponentTest.tester.RunningAverage_instance.DelayValue_instance_3 "DelayValue delays its input value by one evaluation step."
 /begin LOC_MEASUREMENT components.ComponentTest.tester.RunningAverage_instance.DelayValue_instance_3.memory1 components.ComponentTest.tester.RunningAverage_instance.DelayValue_instance_3.memory2 /end LOC_MEASUREMENT
/end FUNCTION
/begin FUNCTION components.ComponentTest.tester.RunningAverage_instance.DelayValue_instance_4 "DelayValue delays its input value by one evaluation step."
 /begin LOC_MEASUREMENT components.ComponentTest.tester.RunningAverage_instance.DelayValue_instance_4.memory1 components.ComponentTest.tester.RunningAverage_instance.DelayValue_instance_4.memory2 /end LOC_MEASUREMENT
/end FUNCTION
/begin FUNCTION components.ComponentTest.tester.RunningAverage_instance.DelayValue_instance_5 "DelayValue delays its input value by one evaluation step."
 /begin LOC_MEASUREMENT components.ComponentTest.tester.RunningAverage_instance.DelayValue_instance_5.memory1 components.ComponentTest.tester.RunningAverage_instance.DelayValue_instance_5.memory2 /end LOC_MEASUREMENT
/end FUNCTION
/begin FUNCTION components.ComponentTest.tester.RunningAverage_instance.DelayValue_instance_6 "DelayValue delays its input value by one evaluation step."
 /begin LOC_MEASUREMENT components.ComponentTest.tester.RunningAverage_instance.DelayValue_instance_6.memory1 components.ComponentTest.tester.RunningAverage_instance.DelayValue_instance_6.memory2 /end LOC_MEASUREMENT
/end FUNCTION
/begin FUNCTION components.ComponentTest.tester.RunningAverage_instance.DelayValue_instance_7 "DelayValue delays its input value by one evaluation step."
 /begin LOC_MEASUREMENT components.ComponentTest.tester.RunningAverage_instance.DelayValue_instance_7.memory1 components.ComponentTest.tester.RunningAverage_instance.DelayValue_instance_7.memory2 /end LOC_MEASUREMENT
/end FUNCTION
/begin FUNCTION components.ComponentTest.tester.RunningAverage_instance.DelayValue_instance_8 "DelayValue delays its input value by one evaluation step."
 /begin LOC_MEASUREMENT components.ComponentTest.tester.RunningAverage_instance.DelayValue_instance_8.memory1 components.ComponentTest.tester.RunningAverage_instance.DelayValue_instance_8.memory2 /end LOC_MEASUREMENT
/end FUNCTION
/begin FUNCTION components.ComponentTest.tester.RunningAverage_instance.DelayValue_instance_9 "DelayValue delays its input value by one evaluation step."
 /begin LOC_MEASUREMENT components.ComponentTest.tester.RunningAverage_instance.DelayValue_instance_9.memory1 components.ComponentTest.tester.RunningAverage_instance.DelayValue_instance_9.memory2 /end LOC_MEASUREMENT
/end FUNCTION
/begin FUNCTION components.ComponentTest.tester.FilterBy_instance ""
 /begin DEF_CHARACTERISTIC components.ComponentTest.tester.FilterBy_instance.K1 components.ComponentTest.tester.FilterBy_instance.K2 /end DEF_CHARACTERISTIC
 /begin SUB_FUNCTION components.ComponentTest.tester.FilterBy_instance.DelayValue_instance /end SUB_FUNCTION
/end FUNCTION
/begin FUNCTION components.ComponentTest.tester.FilterBy_instance.DelayValue_instance "DelayValue delays its input value by one evaluation step."
 /begin LOC_MEASUREMENT components.ComponentTest.tester.FilterBy_instance.DelayValue_instance.memory1 components.ComponentTest.tester.FilterBy_instance.DelayValue_instance.memory2 /end LOC_MEASUREMENT
/end FUNCTION
/begin RECORD_LAYOUT STANDARD_VALUE_R32 /* value */ FNC_VALUES 1 FLOAT32_IEEE COLUMN_DIR DIRECT /end RECORD_LAYOUT
/begin GROUP components.ComponentTest "" ROOT
 /begin REF_CHARACTERISTIC components.ComponentTest.calc_Input components.ComponentTest.calc_Ts components.ComponentTest.calc_qP components.ComponentTest.calc_qI components.ComponentTest.calc_qD components.ComponentTest.calc_PressSet /end REF_CHARACTERISTIC
 /begin REF_MEASUREMENT components.ComponentTest.calc_return /end REF_MEASUREMENT
 /begin SUB_GROUP components.ComponentTest.tester /end SUB_GROUP
/end GROUP
/begin GROUP components.ComponentTest.tester ""
 /begin REF_MEASUREMENT components.ComponentTest.tester.afterFilt components.ComponentTest.tester.afterInp components.ComponentTest.tester.afterRunAv /end REF_MEASUREMENT
 /begin SUB_GROUP components.ComponentTest.tester.FilterBy_instance components.ComponentTest.tester.PID_instance components.ComponentTest.tester.RunningAverage_instance /end SUB_GROUP
/end GROUP
/begin GROUP components.ComponentTest.tester.FilterBy_instance ""
 /begin REF_CHARACTERISTIC components.ComponentTest.tester.FilterBy_instance.K1 components.ComponentTest.tester.FilterBy_instance.K2 /end REF_CHARACTERISTIC
 /begin SUB_GROUP components.ComponentTest.tester.FilterBy_instance.DelayValue_instance /end SUB_GROUP
/end GROUP
/begin GROUP components.ComponentTest.tester.FilterBy_instance.DelayValue_instance "DelayValue delays its input value by one evaluation step."
 /begin REF_MEASUREMENT components.ComponentTest.tester.FilterBy_instance.DelayValue_instance.memory1 components.ComponentTest.tester.FilterBy_instance.DelayValue_instance.memory2 /end REF_MEASUREMENT
/end GROUP
/begin GROUP components.ComponentTest.tester.PID_instance ""
 /begin REF_CHARACTERISTIC components.ComponentTest.tester.PID_instance.cP_Max components.ComponentTest.tester.PID_instance.cP_Min components.ComponentTest.tester.PID_instance.cI_Max components.ComponentTest.tester.PID_instance.cD_Max components.ComponentTest.tester.PID_instance.cD_Min components.ComponentTest.tester.PID_instance.c components.ComponentTest.tester.PID_instance.cI_Min components.ComponentTest.tester.PID_instance.cPID_Max components.ComponentTest.tester.PID_instance.cPID_Min /end REF_CHARACTERISTIC
 /begin REF_MEASUREMENT components.ComponentTest.tester.PID_instance.Error components.ComponentTest.tester.PID_instance.InpOsc components.ComponentTest.tester.PID_instance.afterD components.ComponentTest.tester.PID_instance.afterI components.ComponentTest.tester.PID_instance.afterP components.ComponentTest.tester.PID_instance.pMemory /end REF_MEASUREMENT
 /begin SUB_GROUP components.ComponentTest.tester.PID_instance.DelayValue_instance_5 /end SUB_GROUP
/end GROUP
/begin GROUP components.ComponentTest.tester.PID_instance.DelayValue_instance_5 "DelayValue delays its input value by one evaluation step."
 /begin REF_MEASUREMENT components.ComponentTest.tester.PID_instance.DelayValue_instance_5.memory1 components.ComponentTest.tester.PID_instance.DelayValue_instance_5.memory2 /end REF_MEASUREMENT
/end GROUP
/begin GROUP components.ComponentTest.tester.RunningAverage_instance "" /begin REF_CHARACTERISTIC components.ComponentTest.tester.RunningAverage_instance.c1 /end REF_CHARACTERISTIC
 /begin SUB_GROUP components.ComponentTest.tester.RunningAverage_instance.DelayValue_instance components.ComponentTest.tester.RunningAverage_instance.DelayValue_instance_2 components.ComponentTest.tester.RunningAverage_instance.DelayValue_instance_3 components.ComponentTest.tester.RunningAverage_instance.DelayValue_instance_4 components.ComponentTest.tester.RunningAverage_instance.DelayValue_instance_5 components.ComponentTest.tester.RunningAverage_instance.DelayValue_instance_6 components.ComponentTest.tester.RunningAverage_instance.DelayValue_instance_7 components.ComponentTest.tester.RunningAverage_instance.DelayValue_instance_8 components.ComponentTest.tester.RunningAverage_instance.DelayValue_instance_9 /end SUB_GROUP
/end GROUP
/begin GROUP components.ComponentTest.tester.RunningAverage_instance.DelayValue_instance "DelayValue delays its input value by one evaluation step."
 /begin REF_MEASUREMENT components.ComponentTest.tester.RunningAverage_instance.DelayValue_instance.memory1 components.ComponentTest.tester.RunningAverage_instance.DelayValue_instance.memory2 /end REF_MEASUREMENT
/end GROUP
/begin GROUP components.ComponentTest.tester.RunningAverage_instance.DelayValue_instance_2 "DelayValue delays its input value by one evaluation step."
 /begin REF_MEASUREMENT components.ComponentTest.tester.RunningAverage_instance.DelayValue_instance_2.memory1 components.ComponentTest.tester.RunningAverage_instance.DelayValue_instance_2.memory2 /end REF_MEASUREMENT
/end GROUP
/begin GROUP components.ComponentTest.tester.RunningAverage_instance.DelayValue_instance_3 "DelayValue delays its input value by one evaluation step."
 /begin REF_MEASUREMENT components.ComponentTest.tester.RunningAverage_instance.DelayValue_instance_3.memory1 components.ComponentTest.tester.RunningAverage_instance.DelayValue_instance_3.memory2 /end REF_MEASUREMENT
/end GROUP
/begin GROUP components.ComponentTest.tester.RunningAverage_instance.DelayValue_instance_4 "DelayValue delays its input value by one evaluation step."
 /begin REF_MEASUREMENT components.ComponentTest.tester.RunningAverage_instance.DelayValue_instance_4.memory1 components.ComponentTest.tester.RunningAverage_instance.DelayValue_instance_4.memory2 /end REF_MEASUREMENT
/end GROUP
/begin GROUP components.ComponentTest.tester.RunningAverage_instance.DelayValue_instance_5 "DelayValue delays its input value by one evaluation step."
 /begin REF_MEASUREMENT components.ComponentTest.tester.RunningAverage_instance.DelayValue_instance_5.memory1 components.ComponentTest.tester.RunningAverage_instance.DelayValue_instance_5.memory2 /end REF_MEASUREMENT
/end GROUP
/begin GROUP components.ComponentTest.tester.RunningAverage_instance.DelayValue_instance_6 "DelayValue delays its input value by one evaluation step."
 /begin REF_MEASUREMENT components.ComponentTest.tester.RunningAverage_instance.DelayValue_instance_6.memory1 components.ComponentTest.tester.RunningAverage_instance.DelayValue_instance_6.memory2 /end REF_MEASUREMENT
/end GROUP
/begin GROUP components.ComponentTest.tester.RunningAverage_instance.DelayValue_instance_7 "DelayValue delays its input value by one evaluation step."
 /begin REF_MEASUREMENT components.ComponentTest.tester.RunningAverage_instance.DelayValue_instance_7.memory1 components.ComponentTest.tester.RunningAverage_instance.DelayValue_instance_7.memory2 /end REF_MEASUREMENT
/end GROUP
/begin GROUP components.ComponentTest.tester.RunningAverage_instance.DelayValue_instance_8 "DelayValue delays its input value by one evaluation step."
 /begin REF_MEASUREMENT components.ComponentTest.tester.RunningAverage_instance.DelayValue_instance_8.memory1 components.ComponentTest.tester.RunningAverage_instance.DelayValue_instance_8.memory2 /end REF_MEASUREMENT
/end GROUP
/begin GROUP components.ComponentTest.tester.RunningAverage_instance.DelayValue_instance_9 "DelayValue delays its input value by one evaluation step."
 /begin REF_MEASUREMENT components.ComponentTest.tester.RunningAverage_instance.DelayValue_instance_9.memory1 components.ComponentTest.tester.RunningAverage_instance.DelayValue_instance_9.memory2 /end REF_MEASUREMENT
/end GROUP
/end MODULE
/end PROJECT
