ASAP2_VERSION 1 41
/begin PROJECT ComponentTest_PC_3_ "Generated by ETAS from Project ComponentTest_PC_3_"
/begin HEADER "" VERSION "000" PROJECT_NO ASD /end HEADER
/begin MODULE ComponentTest_PC_3_ "Generated by ETAS ASCET7 from Project: ComponentTest_PC_3_"
/begin IF_DATA E_TARGET
 /begin SOURCE "Task0" 3 /* period */ 10 QP_BLOB 1 /end SOURCE
 /begin TP_BLOB /* programm id */ 1317032327 /* target id */ 7 0 2 0 /end TP_BLOB
/end IF_DATA
/begin MOD_PAR "" VERSION "000" ADDR_EPK 0x0 EPK "" SUPPLIER "ETAS GmbH" CUSTOMER "xxx" CUSTOMER_NO "000" USER "xxx" PHONE_NO "000" ECU "PC" CPU_TYPE "PCx86" NO_OF_INTERFACES 1 /end MOD_PAR
/begin MOD_COMMON "Common definitions" BYTE_ORDER MSB_LAST ALIGNMENT_BYTE 1 ALIGNMENT_WORD 2 ALIGNMENT_LONG 4 ALIGNMENT_FLOAT32_IEEE 4 ALIGNMENT_FLOAT64_IEEE 8 /end MOD_COMMON
/begin CHARACTERISTIC components.ComponentTest.calc_arg "" VALUE 0x0 STANDARD_VALUE_R32 0.0 esdl_ident -3.4028234663852886E+38 3.4028234663852886E+38 /end CHARACTERISTIC
/begin CHARACTERISTIC components.ComponentTest.calc_arg_2 "" VALUE 0x0 STANDARD_VALUE_R32 0.0 esdl_ident -3.4028234663852886E+38 3.4028234663852886E+38 /end CHARACTERISTIC
/begin CHARACTERISTIC components.ComponentTest.calc_Rest "" VALUE 0x0 STANDARD_VALUE_R32 0.0 esdl_ident -3.4028234663852886E+38 3.4028234663852886E+38 /end CHARACTERISTIC
/begin MEASUREMENT components.ComponentTest.calc_return "" /* datatype */ FLOAT32_IEEE esdl_ident /* resolution */ 1 /* accuracy */ 100.0 -3.4028234663852886E+38 3.4028234663852886E+38 ECU_ADDRESS 0x0 /end MEASUREMENT
/begin COMPU_METHOD esdl_ident "" RAT_FUNC /* format */ "%12.4" /* unit */ "" /* coeffs */ COEFFS 0 1 0 0 0 1 /end COMPU_METHOD
/begin FUNCTION components.ComponentTest ""
 /begin DEF_CHARACTERISTIC components.ComponentTest.calc_arg components.ComponentTest.calc_arg_2 components.ComponentTest.calc_Rest /end DEF_CHARACTERISTIC
 /begin LOC_MEASUREMENT components.ComponentTest.calc_return /end LOC_MEASUREMENT
 /begin SUB_FUNCTION components.ComponentTest.tester /end SUB_FUNCTION
/end FUNCTION
/begin FUNCTION components.ComponentTest.tester "" /end FUNCTION
/begin RECORD_LAYOUT STANDARD_VALUE_R32 /* value */ FNC_VALUES 1 FLOAT32_IEEE COLUMN_DIR DIRECT /end RECORD_LAYOUT
/begin GROUP components.ComponentTest "" ROOT
 /begin REF_CHARACTERISTIC components.ComponentTest.calc_arg components.ComponentTest.calc_arg_2 components.ComponentTest.calc_Rest /end REF_CHARACTERISTIC
 /begin REF_MEASUREMENT components.ComponentTest.calc_return /end REF_MEASUREMENT
 /begin SUB_GROUP components.ComponentTest.tester /end SUB_GROUP
/end GROUP
/begin GROUP components.ComponentTest.tester "" /end GROUP
/end MODULE
/end PROJECT
